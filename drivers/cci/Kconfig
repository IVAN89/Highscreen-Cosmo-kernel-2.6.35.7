## drivers/cci/Kconfig
```kconfig
#
# Compalcomm drivers
#

menuconfig CCI_DRIVERS
        tristate "Compalcomm drivers."                                                                              
        default y

if CCI_DRIVERS

source "drivers/cci/vibrator/Kconfig"
source "drivers/cci/leds/Kconfig"
source "drivers/cci/sensors/yamaha/Kconfig"
source "drivers/cci/klog_collector/Kconfig"
endif
```

## drivers/cci/klog_collector/Kconfig
```kconfig
#Pochun_TKxxx_20101123_Begin
config CCI_KLOG_COLLECTOR
	tristate "Kernel Log Collector"
	default y
#Pochun_TKxxx_20101123_End
```

## drivers/cci/sensors/yamaha/Kconfig
```kconfig
#
# Copyright (c) 2010 Yamaha Corporation
#
# This program is free software; you can redistribute it and/or
# modify it under the terms of the GNU General Public License
# as published by the Free Software Foundation; either version 2
# of the License, or (at your option) any later version.
#
# This program is distributed in the hope that it will be useful,
# but WITHOUT ANY WARRANTY; without even the implied warranty of
# MERCHANTABILITY or FITNESS FOR A PARTICULAR PURPOSE.  See the
# GNU General Public License for more details.
#
# You should have received a copy of the GNU General Public License
# along with this program; if not, write to the Free Software
# Foundation, Inc., 51 Franklin Street, Fifth Floor, Boston, MA  02110-1301,
# USA.
#
config INPUT_YAS529
	tristate "Yamaha YAS529 Geomagnetic Sensor"
	depends on I2C
	default "y"

config INPUT_YAS529_POSITION
	int "YAS529 Mounting Position on Board"
	depends on INPUT_YAS529
	default "5"
	help
	  Chip mounting position (pin 1).
	    0: top, upper-left
	    1: top, upper-right
	    2: top, lower-right
	    3: top, lower-left
	    4: bottom, upper-left
	    5: bottom, upper-right
	    6: bottom, lower-right
	    7: bottom, lower-left

config INPUT_ADXL345
	tristate "Analog Devices ADXL345 Acceleration Sensor"
	depends on I2C
	default "y"

config INPUT_ADXL345_POSITION
	int "ADXL345 Mounting Position on Board"
	depends on INPUT_ADXL345
	default "7"
	help
	  Chip mounting position (pin 1).
	    0: top, upper-left
	    1: top, upper-right
	    2: top, lower-right
	    3: top, lower-left
	    4: bottom, upper-left
	    5: bottom, upper-right
	    6: bottom, lower-right
	    7: bottom, lower-left

config INPUT_ORIENTATION
	tristate "Yamaha Orientation Sensor"
	depends on I2C
	default "y"
```
